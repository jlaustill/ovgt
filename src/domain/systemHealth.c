/**
 * Generated by C-Next Transpiler from: systemHealth.cnx
 * A safer C for embedded systems
 */

#include "systemHealth.h"

#include <Arduino.h>
#include "SystemHealthConfig.h"
#include "systemHealthLogic.h"

#include <stdint.h>
#include <stdbool.h>

// IMXRT1062 System Reset Controller: reset status + retained scratch registers.
/* Register: SRC @ 0x400F8000 */
#define SRC_SRSR (*(volatile uint32_t*)(0x400F8000 + 0x08))
#define SRC_GPR9 (*(volatile uint32_t*)(0x400F8000 + 0x40))

// IMXRT1062 Watchdog 1 (16-bit registers).
/* Register: WDOG1 @ 0x400B8000 */
#define WDOG1_WCR (*(volatile uint16_t*)(0x400B8000 + 0x00))
#define WDOG1_WSR (*(volatile uint16_t*)(0x400B8000 + 0x02))

/* Scope: SystemHealth */
static uint8_t SystemHealth_causeCode = 0U;
static uint32_t SystemHealth_bootCounter = 0U;
static uint32_t SystemHealth_lastFeedMicros = 0U;
static bool SystemHealth_feedSeen = false;

void SystemHealth_enableWatchdog(void) {
    uint16_t wcr = 0x0030U;
    wcr = (uint16_t)((wcr & ~(1U << 2)) | (1U << 2));
    wcr = (uint16_t)((wcr & ~(1U << 1)) | (1U << 1));
    wcr = (uint16_t)((wcr & ~(0xFFU << 8)) | ((OVGT_WATCHDOG_WT & 0xFFU) << 8));
    WDOG1_WCR = wcr;
}

void SystemHealth_init(void) {
    uint32_t srsr = SRC_SRSR;
    SystemHealth_causeCode = SystemHealthLogic_decodeResetCause(srsr);
    SRC_SRSR = srsr;
    uint32_t boots = SRC_GPR9 + 1U;
    SRC_GPR9 = boots;
    SystemHealth_bootCounter = boots;
    SystemHealthLogic_loopTimingReset();
    SystemHealthLogic_vinReset();
    SystemHealth_feedSeen = false;
    if (OVGT_WATCHDOG_ENABLED == 1) {
        SystemHealth_enableWatchdog();
    }
}

void SystemHealth_feed(void) {
    uint32_t now = micros();
    bool first = SystemHealth_feedSeen == false;
    if (first == true) {
        SystemHealth_feedSeen = true;
    } else {
        uint32_t interval = now - SystemHealth_lastFeedMicros;
        SystemHealthLogic_loopTimingRecord(interval);
    }
    SystemHealth_lastFeedMicros = now;
    if (OVGT_WATCHDOG_ENABLED == 1) {
        WDOG1_WSR = 0x5555;
        WDOG1_WSR = 0xAAAA;
    }
}

void SystemHealth_sampleSupply(void) {
    if (OVGT_VIN_ENABLED == 1) {
        uint32_t raw = analogRead(OVGT_VIN_ADC_PIN);
        SystemHealthLogic_vinRecord(raw);
    }
}

void SystemHealth_windowReset(void) {
    SystemHealthLogic_loopTimingReset();
    SystemHealthLogic_vinReset();
}

uint8_t SystemHealth_resetCauseCode(void) {
    return SystemHealth_causeCode;
}

uint32_t SystemHealth_bootCount(void) {
    return SystemHealth_bootCounter;
}

uint32_t SystemHealth_loopMicrosMax(void) {
    return SystemHealthLogic_loopTimingMax();
}

uint32_t SystemHealth_loopMicrosAvg(void) {
    return SystemHealthLogic_loopTimingAvg();
}

int32_t SystemHealth_supplyMillivolts(void) {
    return SystemHealthLogic_vinMinMillivolts();
}
