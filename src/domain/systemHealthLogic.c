/**
 * Generated by C-Next Transpiler from: systemHealthLogic.cnx
 * A safer C for embedded systems
 */

#include "systemHealthLogic.h"

#include <stdint.h>
#include <stdbool.h>

// Pure health-telemetry math: reset-cause decode, loop-timing, Vin conversion.
// No hardware access here so it transpiles to C mode and is native-testable.
// The hardware module systemHealth.cnx feeds real register/ADC values in.
/* Scope: SystemHealthLogic */

uint8_t SystemHealthLogic_decodeResetCause(uint32_t srsr) {
    if (((srsr >> 4U) & 1) == true) {
        return 4;
    }
    if (((srsr >> 7U) & 1) == true) {
        return 5;
    }
    if (((srsr >> 8U) & 1) == true) {
        return 6;
    }
    if (((srsr >> 1U) & 1) == true) {
        return 2;
    }
    if (((srsr >> 3U) & 1) == true) {
        return 3;
    }
    if (((srsr >> 6U) & 1) == true) {
        return 7;
    }
    if (((srsr >> 5U) & 1) == true) {
        return 7;
    }
    if (((srsr >> 2U) & 1) == true) {
        return 8;
    }
    if (((srsr) & 1) == true) {
        return 1;
    }
    return 0;
}
static uint32_t SystemHealthLogic_loopMax = 0U;
static uint32_t SystemHealthLogic_loopSum = 0U;
static uint32_t SystemHealthLogic_loopCount = 0U;

void SystemHealthLogic_loopTimingReset(void) {
    SystemHealthLogic_loopMax = 0U;
    SystemHealthLogic_loopSum = 0U;
    SystemHealthLogic_loopCount = 0U;
}

void SystemHealthLogic_loopTimingRecord(uint32_t intervalMicros) {
    if (intervalMicros > SystemHealthLogic_loopMax) {
        SystemHealthLogic_loopMax = intervalMicros;
    }
    SystemHealthLogic_loopSum = SystemHealthLogic_loopSum + intervalMicros;
    SystemHealthLogic_loopCount = SystemHealthLogic_loopCount + 1U;
}

uint32_t SystemHealthLogic_loopTimingMax(void) {
    return SystemHealthLogic_loopMax;
}

uint32_t SystemHealthLogic_loopTimingAvg(void) {
    if (SystemHealthLogic_loopCount == 0) {
        return 0;
    }
    return SystemHealthLogic_loopSum / SystemHealthLogic_loopCount;
}
static bool SystemHealthLogic_vinSeen = false;
static uint32_t SystemHealthLogic_vinMin = 0U;

uint32_t SystemHealthLogic_rawToMillivolts(uint32_t rawAdc) {
    uint32_t atPin = rawAdc * 3300U / 1023U;
    return atPin * 6;
}

void SystemHealthLogic_vinReset(void) {
    SystemHealthLogic_vinSeen = false;
    SystemHealthLogic_vinMin = 0U;
}

void SystemHealthLogic_vinRecord(uint32_t rawAdc) {
    uint32_t mv = SystemHealthLogic_rawToMillivolts(rawAdc);
    bool first = SystemHealthLogic_vinSeen == false;
    if (first == true) {
        SystemHealthLogic_vinMin = mv;
        SystemHealthLogic_vinSeen = true;
    } else {
        if (mv < SystemHealthLogic_vinMin) {
            SystemHealthLogic_vinMin = mv;
        }
    }
}

int32_t SystemHealthLogic_vinMinMillivolts(void) {
    if (SystemHealthLogic_vinSeen == false) {
        return -1;
    }
    return ((SystemHealthLogic_vinMin) & 0xFFFFFFFFU);
}
