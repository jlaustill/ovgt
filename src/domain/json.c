/**
 * Generated by C-Next Transpiler from: json.cnx
 * A safer C for embedded systems
 */

#include "json.h"

#include <stdint.h>
#include <stdbool.h>
#include <string.h>

// Reusable heap-free NDJSON builder for OVGT telemetry.
// Fixed buffer + cursor, byte-writes only — no heap, no snprintf; deterministic
// and MISRA-clean. Design: docs/plans/2026-06-19-mongodb-telemetry-design.md.
//
// Usage from C++ (transpiled as Json_*):
//   Json_begin();
//   Json_addUint("t_ms", millis()); Json_addStr("mode", "auto"); ...
//   Json_end();
//   for (uint32_t i = 0; i < Json_len(); i++) Serial.write(Json_at(i));
//   Serial.write('\n');
/* Scope: Json */
static char Json_buf[1281] = "";
static uint32_t Json_cursor = 0;
static bool Json_full = false;
static bool Json_needComma = false;

void Json_putByte(uint8_t c) {
    uint32_t i = Json_cursor;
    bool room = i < 1279;
    if (room == true) {
        Json_buf[i] = c;
        Json_cursor = i + 1U;
    } else {
        Json_full = true;
    }
}

void Json_putRaw(const char* s) {
    uint32_t len = strlen(s);
    uint32_t i = 0U;
    while (i < len) {
        uint8_t ch = s[i];
        Json_putByte(ch);
        i = i + 1U;
    }
}

void Json_putUintRaw(uint32_t v) {
    if (v == 0) {
        Json_putByte((uint8_t)'0');
        return;
    }
    uint32_t div = 1U;
    uint32_t t = v;
    while (t >= 10) {
        div = div * 10U;
        t = t / 10U;
    }
    while (div > 0) {
        uint32_t digit = (v / div) % 10U + 48U;
        uint8_t dc = (uint8_t)((digit) & 0xFFU);
        Json_putByte(dc);
        div = div / 10U;
    }
}

void Json_key(const char* k) {
    if (Json_needComma == true) {
        Json_putByte((uint8_t)',');
    }
    Json_needComma = true;
    Json_putByte((uint8_t)'"');
    Json_putRaw(k);
    Json_putByte((uint8_t)'"');
    Json_putByte((uint8_t)':');
}

void Json_begin(void) {
    Json_cursor = 0U;
    Json_full = false;
    Json_needComma = false;
    Json_putByte((uint8_t)'{');
}

void Json_addUint(const char* k, uint32_t v) {
    Json_key(k);
    Json_putUintRaw(v);
}

void Json_addInt(const char* k, int32_t v) {
    Json_key(k);
    bool neg = v < 0;
    if (neg == true) {
        Json_putByte((uint8_t)'-');
        int32_t pos = 0 - v;
        Json_putUintRaw(((pos) & 0xFFFFFFFFU));
    } else {
        Json_putUintRaw(((v) & 0xFFFFFFFFU));
    }
}

void Json_addBool(const char* k, bool v) {
    Json_key(k);
    if (v == true) {
        Json_putRaw("true");
    } else {
        Json_putRaw("false");
    }
}

void Json_addStr(const char* k, const char* v) {
    Json_key(k);
    Json_putByte((uint8_t)'"');
    Json_putRaw(v);
    Json_putByte((uint8_t)'"');
}

void Json_addNull(const char* k) {
    Json_key(k);
    Json_putRaw("null");
}

void Json_addFloat2(const char* k, float v) {
    Json_key(k);
    float x = v;
    bool neg = x < 0.0;
    if (neg == true) {
        Json_putByte((uint8_t)'-');
        x = 0.0 - x;
    }
    uint32_t scaled = (uint32_t)(x * 100.0 + 0.5);
    uint32_t ip = scaled / 100U;
    uint32_t fp = scaled % 100U;
    Json_putUintRaw(ip);
    Json_putByte((uint8_t)'.');
    bool padZero = fp < 10;
    if (padZero == true) {
        Json_putByte((uint8_t)'0');
    }
    Json_putUintRaw(fp);
}

void Json_end(void) {
    Json_putByte((uint8_t)'}');
}

uint8_t Json_at(uint32_t i) {
    return Json_buf[i];
}

uint32_t Json_len(void) {
    return Json_cursor;
}

bool Json_overflowed(void) {
    return Json_full;
}
